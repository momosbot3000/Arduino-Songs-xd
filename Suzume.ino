#include <EEPROM.h>

//Notes[n][3]
  //1    = 32
  //1/2  = 16
  //1/4  = 8
  //1/8  = 4
  //1/16 = 2
  //1/32 = 1
//Notes[n][1]
  //C  = 1  do
  //C# = 2  do#
  //D  = 3  re
  //D#  re#
  //E  = 5  mi
  //F  = 6  fa
  //F# = 7  fa#
  //G  = 8  sol
  //G# = 9  sol#
  //A  = 10 la
  //A# = 11 la#
  //B  = 12 si

   byte Notes[][2] = {
    //Intro - Vocals
    {0 , 4}, //1
    {3 , 4}, {10, 4}, {10, 4}, //2
    {6 , 4}, {5 , 4}, {3 , 4}, {1 , 4}, {10, 3}, {1 , 4}, //3
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    {3 , 4}, {0 , 4}, //16
    //Instrumental - Piano
    {10, 5}, {1 , 6}, {10, 5}, //17
    {8 , 5}, {10, 5}, //18
    {6 , 5}, {8 , 5}, //19
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    {5 , 5}, {1 , 5}, //24
    //Verse - Vocal
    {3 , 4}, {10, 4}, {10, 4}, //25
    {6 , 4}, {5 , 4}, {3 , 4}, {1 , 4}, {10, 3}, {1 , 4}, //26
    {3 , 4}, {5 , 4}, {6 , 4}, {8 , 4}, {6 , 4}, {5 , 4}, //27
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    {3 , 4}, {0 , 4}, {6 , 4}, {8 , 4}, //40
    //Pre-Chorus - Vocals
    {10, 4}, {8 , 4}, {6 , 4}, {8 , 4}, {10, 4}, //41
    {0 , 4}, {6 , 4}, {8 , 4}, //42
    {10, 4}, {8 , 4}, {6 , 4}, {8 , 4}, {10, 4}, //43
    {0 , 4}, {6 , 4}, {8 , 4}, //44
    {10, 4}, {8 , 4}, {6 , 4}, {8 , 4}, {10, 4}, //45
    {0 , 4}, {6 , 4}, {8 , 4}, //46
    {10, 4}, {8 , 4}, {6 , 4}, {8 , 4}, {10, 4}, //47
    //48
    //Chorus I - Vocals
    {3 , 5}, {1 , 5}, {1 , 5}, {1 , 5}, {10, 4}, {10, 4}, {10, 4}, //49
    {10, 4}, {8 , 4}, {8 , 4}, {8 , 4}, {8 , 4}, {6 , 4}, {6 , 4}, {8 , 4}, //50    
    {10, 4}, {0 , 4}, //51
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    {3 , 4}, {6 , 4}, {5 , 4}, {1 , 4}, {3 , 4}, //59
    //60
    {3 , 5}, {1 , 5}, {1 , 5}, {1 , 5}, {10, 4}, {10, 4}, {10, 4}, //61
    {10, 4}, {8 , 4}, {8 , 4}, {8 , 4}, {8 , 4}, {6 , 4}, {6 , 4}, {8 , 4}, //62    
    {10, 4}, {0 , 4}, {6 , 4}, //63
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    {10, 4}, {8 , 4}, {8 , 4}, {6 , 4}, //76
    //Instrumental II - Saxophone 
    {6 , 5}, {10, 5}, {6 , 5}, {5 , 5}, //77
    {3 , 5}, {5 , 5}, //78
    {6 , 5}, {0 , 5}, //79
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    {6 , 4}, {8 , 4}, //84
    //Bridge - Vocals
    {10, 4}, {8 , 4}, {8 , 4}, {6 , 4}, {3 , 4}, //85
    {0 , 4}, {3 , 4}, {1 , 4}, //86
    {3 , 4}, {6 , 4}, {6 , 4}, {8 , 4}, {10, 4}, //87
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    {0 , 4}, //110
    //Instrumental III - Guitar / Piano
    {10, 5}, {3 , 5}, {6 , 5}, {10, 5}, {8 , 5}, {3 , 5}, {5 , 5}, {1, 5}, //111
    {3 , 5}, {0 , 5}, {1 , 5}, {3 , 5}, {6 , 5}, {8 , 5}, //112
    {10, 5}, {3 , 5}, {6 , 5}, {10, 5}, {8 , 5}, {3 , 5}, {5 , 5}, {1, 5}, //113
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    {1 , 6}, {0 , 6}, //119
    //Chorus II - Vocals
    {3 , 5}, {1 , 5}, {1 , 5}, {1 , 5}, {10, 4}, {10, 4}, {10, 4}, //120
    {1 , 4}, {8 , 4}, {8 , 4}, {8 , 4}, {8 , 4}, {6 , 4}, {6 , 4}, {8 , 4}, //121
    {10, 4}, {0 , 4}, //122
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    {3 , 4}, {6 , 4}, {6 , 4}, {8 , 4}, {10, 4}, //130
    //131
    {3 , 5}, {1 , 5}, {1 , 5}, {1 , 5}, {1 , 5}, {10, 4}, {10, 4}, {10, 4}, //132
    {1 , 4}, {8 , 4}, {8 , 4}, {8 , 4}, {8 , 4}, {6 , 4}, {6 , 4}, {8 , 4}, //133
    {10, 4}, {0 , 4}, //134
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    {10, 4}, {8 , 4}, {8 , 4}, {6 , 4}, //147
    //Ending - Vocals / Saxophone
    {6 , 4}, {10, 5}, {6 , 5}, //148
    {5 , 5}, {1 , 5}, //149
    {6 , 5}, //150
  };

void setup() {
  
  Serial.begin(9600);
  pinMode(11, OUTPUT);
  int SizeNotes = (sizeof(Notes) / sizeof(*Notes));
  Serial.println(SizeNotes);
  Play(Notes, SizeNotes, 152, 11);
}


void loop() {
  
}

float Hz(int note, int octave){

  if(note <= 0 || note > 12 || octave < 0){
    return 0.0;
  }
  else{
    if(octave >= 0 && note > 0 && note <= 12){
      float hz = 440 * pow(1.05946309436, 12 * (octave - 4) + note - 10);
      return hz;
    }
  }
}


void Play(byte Notes[][2], int SizeNotes, uint8_t bpm, uint8_t buzzer){
  
  float start = millis();
  float keep = start;
  float beatDuration = 60000 / bpm;

  for (int i = 0; i < SizeNotes; i++) {
    
    float noteDuration = (EEPROM.read(i) * beatDuration) / 8; 
    float Frecuency = Hz(Notes[i][0], Notes[i][1]);

    if(Frecuency > 0){    
      while(millis() <= keep + (noteDuration * 0.9)){
        tone(buzzer, Frecuency);
      }
      while(millis() >= keep + (noteDuration * 0.9) && millis() <= keep + noteDuration){    
        noTone(buzzer);
      }
    }
    else{
      while(millis() <= keep + noteDuration){
        noTone(buzzer);
      }
    }
    keep += noteDuration;
    Serial.println(i);
  }
}